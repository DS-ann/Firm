## Kconfig.projbuild
```kconfig
menu "Firm ESP-IDF configuration"

config FIRM_WIFI_SSID1
    string "Wi-Fi SSID 1"
    default "Lenovo"

config FIRM_WIFI_PASS1
    string "Wi-Fi password 1"
    default "debarghya"

config FIRM_WIFI_SSID2
    string "Wi-Fi SSID 2"
    default "vivo Y15s"

config FIRM_WIFI_PASS2
    string "Wi-Fi password 2"
    default "debarghya1"

config FIRM_WIFI_SSID3
    string "Wi-Fi SSID 3"
    default "POCO5956"

config FIRM_WIFI_PASS3
    string "Wi-Fi password 3"
    default "debarghya2"

config FIRM_WIFI_SSID4
    string "Wi-Fi SSID 4"
    default "TPLink"

config FIRM_WIFI_PASS4
    string "Wi-Fi password 4"
    default "pass2"

config FIRM_MQTT_URI
    string "MQTT URI"
    default "mqtts://5dba91287f8248c1a30195053d3862ed.s1.eu.hivemq.cloud:8883"

config FIRM_MQTT_USER
    string "MQTT username"
    default "Debarghya_Sannigrahi"

config FIRM_MQTT_PASSWORD
    string "MQTT password"
    default "Dsann#5956"

endmenu
```

## sdkconfig.defaults
```kconfig
CONFIG_ESPTOOLPY_FLASHSIZE_4MB=y
CONFIG_BT_ENABLED=y
CONFIG_BT_NIMBLE_ENABLED=y
CONFIG_BT_BLUEDROID_ENABLED=n
CONFIG_BT_CONTROLLER_ENABLED=y
CONFIG_BT_NIMBLE_MAX_CONNECTIONS=5
CONFIG_MBEDTLS_CERTIFICATE_BUNDLE=y
CONFIG_MQTT_PROTOCOL_311=y
CONFIG_PARTITION_TABLE_CUSTOM=y
CONFIG_PARTITION_TABLE_CUSTOM_FILENAME="partitions.csv"
```

## wifi-repeater-espidf/main/Kconfig.projbuild
```kconfig
menu "Wi-Fi Repeater"

config REPEATER_UPSTREAM_SSID
    string "Phone hotspot SSID"
    default "vivo Y15s"
    help
        2.4 GHz SSID of the phone hotspot used as the upstream connection.

config REPEATER_UPSTREAM_PASSWORD
    string "Phone hotspot password"
    default "debarghya1"
    help
        Password for the upstream phone hotspot. Change this locally before flashing.

config REPEATER_AP_SSID
    string "Repeater AP SSID"
    default "ESP32-Repeater"

config REPEATER_AP_PASSWORD
    string "Repeater AP password"
    default "esp32repeater"
    help
        WPA2 password for clients connecting to the ESP32.

config REPEATER_AP_CHANNEL
    int "Repeater AP channel"
    range 1 13
    default 1
    help
        The AP follows the upstream channel once connected. This value is used initially.

endmenu
```
